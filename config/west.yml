## config/west.yml
```yaml
manifest:
  remotes:
    - name: zmkfirmware
      url-base: https://github.com/urob          # <--- ADD REPO
  projects:
    - name: zmk
      remote: zmkfirmware
      revision: mouse-3.2                       # <--- ADD REVISION
      import: app/west.yml
  self:
    path: config
```
